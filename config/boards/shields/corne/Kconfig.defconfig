## config/boards/shields/corne/Kconfig.defconfig
```kconfig
if SHIELD_CORNE_DONGLE

config ZMK_KEYBOARD_NAME
	default "Corne"
	
config ZMK_SPLIT_BLE_ROLE_CENTRAL
	default y
	
config ZMK_USB
	default y

endif


if SHIELD_CORNE_LEFT || SHIELD_CORNE_RIGHT || SHIELD_CORNE_DONGLE

config ZMK_SPLIT
    default y

config ZMK_BLE
	default y

endif
```
